## layers/meta-focalcrest/conf/machine/rk3568-mixtile-edge2.conf
```bitbake
# SPDX-License-Identifier: MIT
# Copyright (c) 2026 Focalcrest

require conf/machine/include/focalcrest-rk3568.inc

MACHINEOVERRIDES =. "edge2:"

KERNEL_DEVICETREE = "rockchip/rk3568-mixtile-edge2.dtb"

UBOOT_MACHINE = "rk3568-mixtile-edge2_defconfig"

MACHINE_FEATURES:append = " wifi bluetooth"

MACHINE_EXTRA_RRECOMMENDS += "firmware-ap6275s"
```

## layers/meta-focalcrest/conf/machine/rk3588-mixtile-blade3.conf
```bitbake
# SPDX-License-Identifier: MIT
# Copyright (c) 2026 Focalcrest

require conf/machine/include/focalcrest-rk3588.inc

MACHINEOVERRIDES =. "blade3:"

KERNEL_DEVICETREE = "rockchip/rk3588-mixtile-blade3.dtb"

UBOOT_MACHINE = "rk3588-mixtile-blade3_defconfig"

MACHINE_FEATURES:append = " wifi"

MACHINE_EXTRA_RRECOMMENDS += "linux-firmware-mali-csffw-arch108"
# RTL8125 x2 and an Intel AX200, both on PCIe
MACHINE_EXTRA_RRECOMMENDS += "linux-firmware-rtl-nic linux-firmware-iwlwifi-misc"
```

## layers/meta-focalcrest/conf/machine/rk3588-mixtile-core3588e.conf
```bitbake
# SPDX-License-Identifier: MIT
# Copyright (c) 2026 Focalcrest

require conf/machine/include/focalcrest-rk3588.inc

MACHINEOVERRIDES =. "core3588e:"

KERNEL_DEVICETREE = "rockchip/rk3588-mixtile-core3588e.dtb"

UBOOT_MACHINE = "rk3588-mixtile-core3588e_defconfig"

MACHINE_EXTRA_RRECOMMENDS += "linux-firmware-mali-csffw-arch108"
```
